//////////////////////////////////////////////////////////////////////////////
//
// Contains resource definitions at Atmel MEGA64
//
// File version: $Name:  $
//
// The '_..X_' prefix is used by C-SPY as an indication that the label should
// not be displayed in the dissassembly window.
//

//////////////////////////////////////////////////////////////////////////////
// Code (flash) segments
-D_..X_INTVEC_SIZE=8C   // 4 bytes * 35 vectors
-D_..X_INTVEC_END=(_..X_INTVEC_BASE+_..X_INTVEC_SIZE-1)
-D_..X_FLASH_BASE=(_..X_INTVEC_BASE+_..X_INTVEC_SIZE)
// We would like the end of flash memory to be 0xDFBF. Trap table starts
// at 0xDFC0 (see boot-cfg.xcl). See bootloader-standalone.c for a mem map. But the size of the
// flash image needs to be a multiple of 128 because of the xmodem protocol used
// in the bootloader.
-D_..X_FLASH_NEND=DF7F  // End of near flash memory
-D_..X_FLASH_END=DF7F   // End of flash memory

//////////////////////////////////////////////////////////////////////////////
// Data (SRAM, external ROM or external NV RAM) memory
-D_..X_SRAM_BASE=100    // Start of ram memory
-D_..X_SRAM_TEND=100    // End of tiny ram memory
-D_..X_SRAM_END=10DD    // End of ram memory (~4k + SFR offset  - reserved ram)

//////////////////////////////////////////////////////////////////////////////
// Internal EEPROM
-D_..X_EEPROM_END=7FF   // End of eeprom memory

//////////////////////////////////////////////////////////////////////////////
// Don't allow use of heap
-D_..X_HEAP_SIZE=0   

//////////////////////////////////////////////////////////////////////////////
// We have no ROM
-D_..X_EXT_ROM_BASE=0 
-D_..X_EXT_ROM_END=0 

//////////////////////////////////////////////////////////////////////////////
// We have no external non-volatile memory
-D_..X_EXT_NV_BASE=_..X_SRAM_BASE 
-D_..X_EXT_NV_END=_..X_SRAM_END 

//////////////////////////////////////////////////////////////////////////////
// Don't allow placement of stack in external memory 
-D_..X_EXT_CSTACK_BASE=0 
-D_..X_EXT_CSTACK_END=0 
-D_..X_EXT_RSTACK_BASE=0 
-D_..X_EXT_RSTACK_END=0 

//////////////////////////////////////////////////////////////////////////////
// Fill interrupt vector table with RETIs
-h_..X_INTVEC_BASE-_..X_INTVEC_END -H1895

//////////////////////////////////////////////////////////////////////////////
//
// Configuration for a generic -v3 -ms target.
//
// File version:  $Name: V1_27I V1_27G X1_27F V1_27E V2_27D $
//
// The '_..X_' prefix is used by C-SPY as an indication that the label should
// not be displayed in the dissassembly window.
//

// Set up XLINK
-ca90
-w29

//////////////////////////////////////////////////////////////////////////////
// Code (flash) segments
-Z(CODE)INTVEC=_..X_INTVEC_BASE-_..X_INTVEC_END
//-Z(CODE)TINY_F=_..X_FLASH_BASE-FF
-Z(CODE)NEAR_F=_..X_FLASH_BASE-_..X_FLASH_NEND
-Z(CODE)SWITCH=_..X_FLASH_BASE-_..X_FLASH_NEND
-Z(CODE)DIFUNCT=_..X_FLASH_BASE-_..X_FLASH_NEND
-Z(CODE)CODE=_..X_FLASH_BASE-_..X_FLASH_END
-Z(CODE)FAR_F=[_..X_FLASH_BASE-_..X_FLASH_END]/10000
-Z(CODE)INITTAB=[_..X_FLASH_BASE-_..X_FLASH_END]/10000
-Z(CODE)HUGE_F=_..X_FLASH_BASE-_..X_FLASH_END
//-Z(CODE)TINY_ID=_..X_FLASH_BASE-_..X_FLASH_END
-Z(CODE)NEAR_ID=_..X_FLASH_BASE-_..X_FLASH_END
-Z(CODE)CHECKSUM=_..X_FLASH_BASE-_..X_FLASH_END

//////////////////////////////////////////////////////////////////////////////
// Data (SRAM, external ROM or external NV RAM) memory
//-Z(DATA)TINY_I,TINY_Z,TINY_N=_..X_SRAM_BASE-_..X_SRAM_TEND
-Z(DATA)CSTACK+_..X_CSTACK_SIZE=_..X_SRAM_BASE-_..X_SRAM_END,_..X_EXT_CSTACK_BASE-_..X_EXT_CSTACK_END
-Z(DATA)HEAP+_..X_HEAP_SIZE=_..X_SRAM_BASE-_..X_SRAM_END,_..X_EXT_SRAM_BASE-_..X_EXT_SRAM_END
-Z(DATA)RSTACK+_..X_RSTACK_SIZE=_..X_SRAM_BASE-_..X_SRAM_END,_..X_EXT_RSTACK_BASE-_..X_EXT_RSTACK_END
-Z(DATA)NEAR_I,NEAR_Z=_..X_SRAM_BASE-_..X_SRAM_END,_..X_EXT_SRAM_BASE-_..X_EXT_SRAM_END
-Z(DATA)NEAR_C=_..X_EXT_ROM_BASE-_..X_EXT_ROM_END
-Z(DATA)NEAR_N=_..X_EXT_NV_BASE-_..X_EXT_NV_END

//////////////////////////////////////////////////////////////////////////////
// Internal EEPROM

-Z(XDATA)EEPROM_I,EEPROM_N=1-_..X_EEPROM_END
